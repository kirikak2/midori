## main/Kconfig.projbuild
```kconfig
menu "USB MIDI Host Configuration"

    choice USB_MIDI_BOARD_TYPE
        prompt "Target Board"
        default USB_MIDI_BOARD_FREENOVE
        help
            Select the target hardware board.

        config USB_MIDI_BOARD_FREENOVE
            bool "Freenove ESP32-S3"
            help
                Freenove ESP32-S3 board with separate USB-C for host and serial.
                Logs output to serial console.

        config USB_MIDI_BOARD_M5STACK_CORES3
            bool "M5Stack CoreS3 SE"
            help
                M5Stack CoreS3 SE board with shared USB-C.
                Logs output to LCD display.

        config USB_MIDI_BOARD_M5STACK_TAB5
            bool "M5Stack Tab5 (ESP32-P4)"
            help
                M5Stack Tab5 with ESP32-P4 (RISC-V), 5-inch 1280x720 display.
                USB-A port for USB-MIDI host.
                USB-C port for serial console and USB device mode.
                Larger screen supports 4x3 pad grid (12 pads).

        config USB_MIDI_BOARD_ELECROW_CROWPANEL
            bool "Elecrow CrowPanel Advanced 7inch (ESP32-P4)"
            help
                Elecrow CrowPanel Advanced 7.0 inch with ESP32-P4 (RISC-V),
                1024x600 MIPI-DSI display (EK79007) and a GT911 touch panel.
                Two USB-C connectors: one is a CH343 USB-UART bridge (flashing
                and console), the other is wired to the ESP32-P4's USB 2.0
                controller.
                Screen supports the same 4x3 pad grid as the Tab5 (12 pads).
    endchoice

    config USB_MIDI_UI_ENABLED
        bool
        default y if USB_MIDI_BOARD_M5STACK_CORES3
        default y if USB_MIDI_BOARD_M5STACK_TAB5
        default y if USB_MIDI_BOARD_ELECROW_CROWPANEL
        default n
        help
            Derived (not user-visible): whether this board has a display and
            touch panel, and therefore builds the on-device UI (main/ui) and
            the LCD boot console. Boards without one (Freenove) log to serial.

    choice USB_MIDI_USB_MODE
        prompt "USB port mode"
        default USB_MIDI_USB_MODE_HOST
        help
            Selects what the USB device-capable port is used for.

            On ESP32-S3 boards (Freenove / CoreS3) there is a single USB
            connector wired to one internal USB PHY, shared by the USB-OTG
            controller and the USB-Serial/JTAG controller. Only one of the
            three modes below can be active in a given build.

            On the Tab5 (ESP32-P4) this setting only describes the USB-C
            port. The USB-A port is always a USB-MIDI host, independent of
            this choice.

            On the CrowPanel (ESP32-P4) this describes the "USB 2.0" USB-C
            connector, which is wired to the chip's high-speed OTG port.
            Flashing always goes through the separate CH343 UART bridge, so
            'serial' is not available there (USB-Serial/JTAG is not brought
            out to any connector).

        config USB_MIDI_USB_MODE_HOST
            bool "USB-MIDI host (no USB device)"
            help
                The USB port acts as a USB-MIDI host (connect a keyboard,
                groovebox, etc.). Console output goes to UART.

                On Tab5 this means the USB-C port is left unused.

        config USB_MIDI_USB_MODE_SERIAL
            bool "USB-Serial/JTAG console (device)"
            help
                The USB port is driven by the built-in USB-Serial/JTAG
                controller: serial console, flashing and JTAG debugging all
                work over it.

                On ESP32-S3 this disables the USB-MIDI host, since the
                USB-OTG controller cannot have the PHY at the same time.

        config USB_MIDI_USB_MODE_MIDI_DEVICE
            bool "USB-MIDI device (TinyUSB CDC + MIDI)"
            help
                The USB port is driven by TinyUSB as a composite CDC + MIDI
                device, so the board shows up as a USB-MIDI instrument on a
                PC/tablet. The console is redirected to the CDC interface.

                USB-Serial/JTAG is disconnected in this mode, so flashing
                requires entering download mode manually (BOOT + RESET) and
                hardware JTAG debugging is unavailable.

                On ESP32-S3 this disables the USB-MIDI host, since the
                USB-OTG controller is used for the device role instead.
    endchoice

    config USB_MIDI_HOST_ENABLED
        bool
        default y if USB_MIDI_BOARD_M5STACK_TAB5
        default y if USB_MIDI_USB_MODE_HOST
        default n
        help
            Derived (not user-visible): whether a USB-MIDI host controller
            is available in this build. Tab5 always has one on USB-A; the
            single-port ESP32-S3 boards only have one in USB host mode.

    config USB_MIDI_CONSOLE_ON_CDC
        bool
        default y if USB_MIDI_USB_MODE_MIDI_DEVICE
        default n
        help
            Derived (not user-visible): whether the serial console rides on
            the TinyUSB CDC interface instead of UART / USB-Serial-JTAG.

            This is what makes `idf.py monitor` follow the USB-MIDI device
            connector in that mode. Note what that means on the console you
            were watching before: the log stops at "TinyUSB Driver installed"
            and everything after it goes to the other connector, which looks
            exactly like a hang if nothing is listening there.

            On the CrowPanel, flashing still happens over its CH343 UART
            bridge; only the console moves. Build in 'host' mode instead to
            keep the console on UART.

    menu "Display Settings"
        depends on USB_MIDI_UI_ENABLED

        config USB_MIDI_LCD_FONT_SIZE
            int "LCD Font Size (pixels)"
            default 1
            range 1 3
            help
                Font size multiplier for LCD console text.
                1 = small (6x8), 2 = medium (12x16), 3 = large (18x24)

        config USB_MIDI_LCD_BACKLIGHT_LEVEL
            int "LCD Backlight Level (0-255)"
            default 200
            range 0 255
            help
                Backlight brightness level.

    endmenu

    menu "SD Card Settings"
        config USB_MIDI_SDCARD_ENABLED
            bool "Enable SD Card"
            default y
            help
                Enable SD card support for loading app.rb script.

        menu "M5Stack CoreS3 SD Card Pins"
            depends on USB_MIDI_BOARD_M5STACK_CORES3 && USB_MIDI_SDCARD_ENABLED

            config USB_MIDI_SDCARD_M5_CLK
                int "SD CLK GPIO"
                default 36
            config USB_MIDI_SDCARD_M5_MOSI
                int "SD MOSI GPIO"
                default 37
            config USB_MIDI_SDCARD_M5_MISO
                int "SD MISO GPIO"
                default 35
            config USB_MIDI_SDCARD_M5_CS
                int "SD CS GPIO"
                default 4
        endmenu

        menu "Freenove SD Card Pins"
            depends on USB_MIDI_BOARD_FREENOVE && USB_MIDI_SDCARD_ENABLED

            config USB_MIDI_SDCARD_FREENOVE_CLK
                int "SD CLK GPIO"
                default 12
            config USB_MIDI_SDCARD_FREENOVE_MOSI
                int "SD MOSI GPIO"
                default 11
            config USB_MIDI_SDCARD_FREENOVE_MISO
                int "SD MISO GPIO"
                default 13
            config USB_MIDI_SDCARD_FREENOVE_CS
                int "SD CS GPIO"
                default 10
        endmenu

        menu "M5Stack Tab5 SD Card Pins"
            depends on USB_MIDI_BOARD_M5STACK_TAB5 && USB_MIDI_SDCARD_ENABLED

            config USB_MIDI_SDCARD_TAB5_CLK
                int "SD CLK GPIO"
                default 43
                help
                    Tab5 SD card clock pin (SPI mode)
            config USB_MIDI_SDCARD_TAB5_MOSI
                int "SD MOSI GPIO"
                default 44
                help
                    Tab5 SD card MOSI pin (SPI mode)
            config USB_MIDI_SDCARD_TAB5_MISO
                int "SD MISO GPIO"
                default 39
                help
                    Tab5 SD card MISO pin (SPI mode)
            config USB_MIDI_SDCARD_TAB5_CS
                int "SD CS GPIO"
                default 42
                help
                    Tab5 SD card chip select pin (SPI mode)
        endmenu

        config USB_MIDI_SDCARD_MOUNT_POINT
            string "SD Card Mount Point"
            default "/sd"
            depends on USB_MIDI_SDCARD_ENABLED
            help
                Mount point for the SD card filesystem (PicoRuby uses /sd).

        config USB_MIDI_APP_SCRIPT_PATH
            string "Ruby Script Path"
            default "/sd/app.rb"
            depends on USB_MIDI_SDCARD_ENABLED
            help
                Path to the Ruby script to execute on startup.
    endmenu

endmenu
```
